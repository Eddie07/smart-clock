/*
 * leds-project dts overlay
 */

/dts-v1/;
/plugin/;

/ {
	fragment@0 {
    		target-path = "/";
    		__overlay__ {
        	     gpio-leds {
               			compatible = "gpio-leds,project1";
				gpio_red   = <17>;
				
        			};
			     };

		   };
};


